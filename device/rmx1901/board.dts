/dts-v1/;

// realme X (RMX1901). Started by tools/boards.py new from phone.dts.
// Every value here is to be checked against the device before it is relied on (Documentation/porting.md).
/ {
	name = "rmx1901";                       // what the loader puts in /chosen/darwin-board
	description = "realme X (RMX1901)";
	soc = "sdm710";

	// Nothing yet: a feature is listed once its driver has been seen to work on this board
	// (Documentation/porting.md goes through them in the order to try).
	features = <>;

	// The panel: qcom,mdss_dsi_oppo18041samsung_ams653tk01_1080_2340_cmd
	backlight {
		type = "soft";
	};

	// The PMIC's real-time clock, read once at boot (rtc=0 leaves it alone): SPMI slave << 8 | the high byte
	// of its RTC_RW block's registers.
	rtc {
		peripheral = <0x060>;
		name = "the PM660's RTC";
	};
};
